## CMakeLists.txt
```
# SPDX-License-Identifier: Apache-2.0

cmake_minimum_required(VERSION 3.20.0)
find_package(Zephyr REQUIRED HINTS $ENV{ZEPHYR_BASE})
project(lab6)

target_sources(app PRIVATE 
    src/app_thread.c
    src/data_mgr.c
    src/main.c
    src/sensor_thread.c    
)

target_sources_ifdef(CONFIG_SHELL app PRIVATE 
    src/shell_commands.c)
```

## prj.conf
```kconfig
CONFIG_GPIO=y
CONFIG_THREAD_NAME=y
CONFIG_ENTROPY_GENERATOR=y
CONFIG_TEST_RANDOM_GENERATOR=y

CONFIG_LOG=y
CONFIG_LOG_DEFAULT_LEVEL=3
CONFIG_LOG_BUFFER_SIZE=2048
CONFIG_LOG_BACKEND_UART=y
CONFIG_LOG_MODE_DEFERRED=y

CONFIG_SHELL=y
CONFIG_SHELL_BACKEND_SERIAL=y
CONFIG_SHELL_LOG_BACKEND=y
CONFIG_KERNEL_SHELL=y
CONFIG_THREAD_MONITOR=y
CONFIG_DEVICE_SHELL=y
```

## src/main.c
```c
/*
 * Copyright (c) 2016 Intel Corporation
 *
 * SPDX-License-Identifier: Apache-2.0
 */

#include <stdio.h>
#include <zephyr/app_version.h>
#include <zephyr/kernel.h>
#include <zephyr/version.h>
#include <zephyr/drivers/gpio.h>
#include <zephyr/logging/log.h>
#include "sensor_thread.h"
#include "app_thread.h"

LOG_MODULE_REGISTER(main, LOG_LEVEL_DBG);

/* 1000 msec = 1 sec */
#define SLEEP_TIME_MS 1000

/* The devicetree node identifier for the "led0" alias. */
#define LED0_NODE DT_ALIAS(led0)

/*
 * A build error on this line means your board is unsupported.
 * See the sample documentation for information on how to fix this.
 */
static const struct gpio_dt_spec led = GPIO_DT_SPEC_GET(LED0_NODE, gpios);

/* static void print_system_info(void)
{
	printk("\n");
	printk("========================================\n");
	printk(" Lab 6: Threading Fundamentals\n");
	printk("========================================\n");
	printk("System initialized successfully\n");
	printk("Current thread: %s\n", k_thread_name_get(k_current_get()));
	printk("Main thread priority: %d\n", k_thread_priority_get(k_current_get()));
	printk("========================================\n");
	printk("\n");
}

static void print_idle_thread_info(void)
{
	printk("\n");
	printk("--- Idle Thread Information ---\n");
	printk("The idle thread runs when no other threads are ready.\n");
	printk("It has the lowest priority in the system.\n");
	printk("During idle, the CPU can enter low-power modes.\n");
	printk("-------------------------------\n");
	printk("\n");
} */

int main(void)
{
	LOG_INF("Firmware version: %s", APP_VERSION_STRING);
	LOG_INF("Zephyr: %s", KERNEL_VERSION_STRING);
	LOG_INF("Board: %s", CONFIG_BOARD);
	// print_system_info();
	LOG_DBG("Debug: Application starting");
	LOG_INF("SkyWatch Weather Station - Lab 8");
	LOG_INF("Main thread: %s (priority %d)", k_thread_name_get(k_current_get()),
		k_thread_priority_get(k_current_get()));

	int ret;

	/* 	printk("\n========================================\n");
		printk(" SkyWatch Weather Station - Lab 6\n");
		printk("========================================\n");
		printk("Main thread: %s (priority %d)\n", k_thread_name_get(k_current_get()),
	   k_thread_priority_get(k_current_get()));
		printk("========================================\n\n"); */

	if (!gpio_is_ready_dt(&led)) {
		printk("Error: LED not ready\n");
		return -1;
	}

	ret = gpio_pin_configure_dt(&led, GPIO_OUTPUT_ACTIVE);
	if (ret < 0) {
		return 0;
	}

	/* 	printk("[Main] Threads running:\n");
		printk(" - Main: heartbeat LED (priority 0)\n");
		printk(" - Sensor: temperature sampling (priority 5)\n");
		printk(" - App: controller/alerts (priority 7)\n\n");

		printk("LED will blink every %d ms\n", SLEEP_TIME_MS);
		printk("Main thread entering blink loop...\n\n"); */

	// print_idle_thread_info();

	while (1) {
		gpio_pin_toggle_dt(&led);
		k_msleep(SLEEP_TIME_MS);
	}
	return 0;
}
```

## src/app_thread.c
```c
#include "app_thread.h"
#include "data_mgr.h"
#include "sensor_thread.h"
#include <zephyr/kernel.h>
#include <zephyr/logging/log.h>

LOG_MODULE_REGISTER(app, LOG_LEVEL_INF);

#define APP_STACK_SIZE 1024
#define APP_PRIORITY 7
#define APP_INTERVAL_MS 3000

#define TEMP_HIGH_THRESHOLD 28.0f
#define TEMP_LOW_THRESHOLD 22.0f

static struct k_work alert_work;

void alert_work_handler(struct k_work *work)
{
	LOG_INF("[Alert] Processing temperature alert\n");
	LOG_INF("[Alert] Logging event...\n");
	k_msleep(50); /* Simulate logging delay */
	LOG_INF("[Alert] Alert processing complete\n");
}

static void app_thread_entry(void *p1, void *p2, void *p3)
{

	// printk("[App] Controller thread started (priority %d)\n",
	// k_thread_priority_get(k_current_get()));
	k_work_init(&alert_work, alert_work_handler);

	while (1) {
		// int ret = data_mgr_wait_for_data(K_FOREVER);
		struct sensor_data reading;
		int ret = data_mgr_receive(&reading, K_FOREVER);

		if (ret == 0) {
			LOG_INF("Received: %d.%d C,\n", (int)reading.temperature,
				(int)((reading.temperature - (int)reading.temperature) * 10));

			if (reading.temperature > TEMP_HIGH_THRESHOLD) {
				// printk("[App] ALERT: Temperature HIGH! Submitting alert...\n");
				LOG_WRN("ALERT: Temperature HIGH!");
				k_work_submit(&alert_work);
			}
			/*          struct sensor_data reading = data_mgr_read();
				    if (reading.valid)
				    {
					float temp = reading.temperature;
					printk("[App] Reading sensor: %d.%d C (age: %u ms)\n",
						(int)temp,
						(int)((temp - (int)temp) * 10),
						k_uptime_get_32() - reading.timestamp);

					if (temp > TEMP_HIGH_THRESHOLD)
					{
						printk("[App] ALERT: Temperature HIGH!\n");
					}
					else if (temp < TEMP_LOW_THRESHOLD)
					{
						printk("[App] ALERT: Temperature LOW!\n");
					}
					else
					{
						printk("[App] Temperature normal\n");
					}

					}
				    else
				    {
					printk("[App] Waiting for sensor data...\n");
				    } */
			/* code */
		}

		// k_msleep(APP_INTERVAL_MS);
	}
}

K_THREAD_DEFINE(app_tid, APP_STACK_SIZE, app_thread_entry, NULL, NULL, NULL, APP_PRIORITY, 0, 0);
```

## src/app_thread.h
```c
#ifndef APP_THREAD_H
#define APP_THREAD_H

#include <zephyr/kernel.h>

#endif /* APP_THREAD_H */
```

## src/data_mgr.c
```c
#include "sensor_thread.h"
#include <zephyr/kernel.h>

// static K_MUTEX_DEFINE(data_mutex);
// static K_SEM_DEFINE(data_ready_sem, 0, 1);

#define MSG_QUEUE_SIZE 4

K_MSGQ_DEFINE(sensor_msgq, sizeof(struct sensor_data), MSG_QUEUE_SIZE, 4);

void data_mgr_post(struct sensor_data *data)
{
	/* Non-blocking put - drop oldest if full */
	if (k_msgq_put(&sensor_msgq, data, K_NO_WAIT) != 0) {
		k_msgq_purge(&sensor_msgq);
		k_msgq_put(&sensor_msgq, data, K_NO_WAIT);
	}
}

int data_mgr_receive(struct sensor_data *data, k_timeout_t timeout)
{
	return k_msgq_get(&sensor_msgq, data, timeout);
}

/* void data_mgr_write(float temperature)
{
    k_mutex_lock(&data_mutex, K_FOREVER);
    latest_reading.temperature = temperature;
    latest_reading.timestamp = k_uptime_get_32();
    latest_reading.valid = true;
    k_mutex_unlock(&data_mutex);

    k_sem_give(&data_ready_sem);
}

int data_mgr_wait_for_data(k_timeout_t timeout)
{
    return k_sem_take(&data_ready_sem, timeout);
}

struct sensor_data data_mgr_read(void)
{
    struct sensor_data copy;
    k_mutex_lock(&data_mutex, K_FOREVER);
    copy = latest_reading;
    k_mutex_unlock(&data_mutex);
    return copy;
} */
```

## src/data_mgr.h
```c
#ifndef DATA_MGR_H
#define DATA_MGR_H

#include "sensor_thread.h"

// void data_mgr_write(float temperature);
// struct sensor_data data_mgr_read(void);

void data_mgr_post(struct sensor_data *data);
int data_mgr_receive(struct sensor_data *data, k_timeout_t timeout);

#endif /* DATA_MGR_H */
```

## src/sensor_thread.c
```c
#include "data_mgr.h"
#include "sensor_thread.h"
#include <zephyr/kernel.h>
#include <zephyr/logging/log.h>
#include <zephyr/random/random.h>

LOG_MODULE_REGISTER(sensor, LOG_LEVEL_INF);

#define SENSOR_STACK_SIZE 1024
#define SENSOR_PRIORITY 5
#define SAMPLE_INTERVAL_MS 2000

static float read_temperature(void)
{
	float base = 25.0f;
	float variation = ((float)(sys_rand32_get() % 100) - 50) / 10.0f;
	return base + variation;
}

static void sensor_thread_entry(void *p1, void *p2, void *p3)
{
	// printk("[Sensor] Thread started (priority %d)\n",
	// k_thread_priority_get(k_current_get()));

	while (1) {
		float temp;
		struct sensor_data reading;
		reading.temperature = read_temperature();
		reading.timestamp = k_uptime_get_32();
		reading.valid = true;
		temp = reading.temperature;
		data_mgr_post(&reading);
		LOG_INF("Temperature: %d.%d C", (int)temp, (int)((temp - (int)temp) * 10));
		// data_mgr_write(temp);

		// printk("[Sensor] Temperature: %d.%d C\n", (int)temp, (int)((temp - (int)temp) *
		// 10));

		k_msleep(SAMPLE_INTERVAL_MS);
	}
}

K_THREAD_DEFINE(sensor_tid, SENSOR_STACK_SIZE, sensor_thread_entry, NULL, NULL, NULL,
		SENSOR_PRIORITY, 0, 0);
```

## src/sensor_thread.h
```c
#ifndef SENSOR_THREAD_H
#define SENSOR_THREAD_H

#include <zephyr/kernel.h>

struct sensor_data {
	float temperature;
	uint32_t timestamp;
	bool valid;
};

#endif /* SENSOR_THREAD_H */
```

## src/shell_commands.c
```c
#include <zephyr/kernel.h>
#include <zephyr/shell/shell.h>

static int cmd_skywatch_status(const struct shell *sh, size_t argc, char **argv)
{
	shell_print(sh, "SkyWatch Status:");
	shell_print(sh, " Uptime: %lld ms", k_uptime_get());
	shell_print(sh, " Threads: main, sensor, app");
	return 0;
}

static int cmd_skywatch_version(const struct shell *sh, size_t argc, char **argv)
{
	shell_print(sh, "SkyWatch Weather Station");
	shell_print(sh, " Build: " __DATE__ " " __TIME__);
	shell_print(sh, " Board: %s", CONFIG_BOARD);
	return 0;
}

SHELL_STATIC_SUBCMD_SET_CREATE(sub_skywatch,
			       SHELL_CMD(status, NULL, "Show SkyWatch status", cmd_skywatch_status),
			       SHELL_CMD(version, NULL, "Show version info", cmd_skywatch_version),
			       SHELL_SUBCMD_SET_END);

SHELL_CMD_REGISTER(skywatch, &sub_skywatch, "SkyWatch commands", NULL);
```
