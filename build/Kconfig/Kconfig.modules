## build/Kconfig/Kconfig.modules
```kconfig
menu "cmsis (C:/ZephyrTraining/skywatch/modules/hal/cmsis)"
osource "$(ZEPHYR_CMSIS_KCONFIG)"
config ZEPHYR_CMSIS_MODULE
	bool
	default y
endmenu
menu "hal_nxp (C:/ZephyrTraining/skywatch/modules/hal/nxp)"
osource "$(ZEPHYR_HAL_NXP_KCONFIG)"
config ZEPHYR_HAL_NXP_MODULE
	bool
	default y

config ZEPHYR_HAL_NXP_MODULE_BLOBS
	bool
endmenu
```

## build/Kconfig/Kconfig.sysbuild.modules
```kconfig
config ZEPHYR_CMSIS_MODULE
   bool
   default y
config ZEPHYR_HAL_NXP_MODULE
   bool
   default y
```

## build/Kconfig/arch/Kconfig
```kconfig
# Load Zephyr Arch Kconfig descriptions.
osource "C:/ZephyrTraining/skywatch/zephyr/arch/rx/Kconfig"
osource "C:/ZephyrTraining/skywatch/zephyr/arch/x86/Kconfig"
osource "C:/ZephyrTraining/skywatch/zephyr/arch/xtensa/Kconfig"
osource "C:/ZephyrTraining/skywatch/zephyr/arch/sparc/Kconfig"
osource "C:/ZephyrTraining/skywatch/zephyr/arch/riscv/Kconfig"
osource "C:/ZephyrTraining/skywatch/zephyr/arch/posix/Kconfig"
osource "C:/ZephyrTraining/skywatch/zephyr/arch/mips/Kconfig"
osource "C:/ZephyrTraining/skywatch/zephyr/arch/arm64/Kconfig"
osource "C:/ZephyrTraining/skywatch/zephyr/arch/arm/Kconfig"
osource "C:/ZephyrTraining/skywatch/zephyr/arch/arc/Kconfig"
```

## build/Kconfig/boards/Kconfig
```kconfig
# Load Zephyr board Kconfig descriptions.
osource "C:/ZephyrTraining/skywatch/zephyr/boards/nxp/frdm_mcxn947/Kconfig"
```

## build/Kconfig/boards/Kconfig.defconfig
```kconfig
# Load Zephyr board defconfig descriptions.
osource "C:/ZephyrTraining/skywatch/zephyr/boards/nxp/frdm_mcxn947/Kconfig.defconfig"
```

## build/Kconfig/boards/Kconfig.frdm_mcxn947
```kconfig
# Load board Kconfig descriptions.
osource "C:/ZephyrTraining/skywatch/zephyr/boards/nxp/frdm_mcxn947/Kconfig.frdm_mcxn947"
```

## build/Kconfig/boards/Kconfig.sysbuild
```kconfig
# Load Sysbuild board Kconfig descriptions.
osource "C:/ZephyrTraining/skywatch/zephyr/boards/nxp/frdm_mcxn947/Kconfig.sysbuild"
```

## lab8/tests/unit/testcase.yaml
```yaml
tests:
  skywatch.unit.temperature:
    tags: unit sensor
    platform_allow:
      - native_sim
      - frdm_mcxn947/mcxn947/cpu0
    integration_platforms:
      - native_sim
    harness: ztest
    timeout: 60
```
